## boards/shields/acari/Kconfig.defconfig
```kconfig
# Copyright (c) 2020 The ZMK Contributors
# SPDX-License-Identifier: MIT

if SHIELD_ACARI_LEFT

config ZMK_KEYBOARD_NAME
	default "acari"

config ZMK_SPLIT_ROLE_CENTRAL
	default y

endif

if SHIELD_ACARI_LEFT || SHIELD_ACARI_RIGHT

config ZMK_SPLIT
	default y

endif
```

## config/boards/shields/acari/Kconfig.defconfig
```kconfig
# Copyright (c) 2020 The ZMK Contributors
# SPDX-License-Identifier: MIT
CONFIG_ZMK_SPLIT_BLE_CENTRAL_BATTERY_LEVEL_FETCHING=y
CONFIG_ZMK_SPLIT_BLE_CENTRAL_BATTERY_LEVEL_PROXY=y
if SHIELD_ACARI_LEFT

config ZMK_KEYBOARD_NAME
	default "acari"

config ZMK_SPLIT_ROLE_CENTRAL
	default y

endif

if SHIELD_ACARI_LEFT || SHIELD_ACARI_RIGHT

config ZMK_SPLIT
	default y

endif
```

## config/boards/shields/acari/Kconfig.shield
```kconfig
# Copyright (c) 2022 The ZMK Contributors
# SPDX-License-Identifier: MIT
CONFIG_ZMK_SPLIT_BLE_CENTRAL_BATTERY_LEVEL_FETCHING=y
CONFIG_ZMK_SPLIT_BLE_CENTRAL_BATTERY_LEVEL_PROXY=y
config SHIELD_ACARI_LEFT
	def_bool $(shields_list_contains,acari_left)

config SHIELD_ACARI_RIGHT
	def_bool $(shields_list_contains,acari_right)
```

## config/west.yml
```yaml
manifest:
  remotes:
    - name: suriaribeiro
      url-base: https://github.com/suriaribeiro
  projects:
    - name: zmk
      remote: suriaribeiro
      revision: main
      import: app/west.yml
  self:
    path: config
```
